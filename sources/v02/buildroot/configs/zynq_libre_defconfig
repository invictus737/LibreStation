## sources/v02/buildroot/configs/zynq_libre_defconfig
```kconfig
BR2_arm=y
BR2_cortex_a9=y
BR2_ARM_ENABLE_NEON=y
BR2_ARM_ENABLE_VFP=y
BR2_ARM_FPU_NEON=y
BR2_TOOLCHAIN_EXTERNAL=y
BR2_TOOLCHAIN_EXTERNAL_LINARO_ARM=y
BR2_OPTIMIZE_3=y
BR2_PACKAGE_ETHTOOL=y
BR2_PACKAGE_ETHTOOL_PRETTY_PRINT=y
BR2_PACKAGE_HTOP=y
BR2_PACKAGE_NANO=y
BR2_TARGET_GENERIC_HOSTNAME="LibreStation"
BR2_TARGET_GENERIC_ISSUE="Welcome to LibreStation by YO3TCO"
BR2_ROOTFS_DEVICE_CREATION_DYNAMIC_MDEV=y
BR2_TARGET_GENERIC_ROOT_PASSWD="analog"
BR2_TARGET_GENERIC_GETTY_PORT="ttyPS0"
BR2_ROOTFS_POST_BUILD_SCRIPT="board/libre/post-build.sh"
BR2_PACKAGE_ZSTD=y
BR2_PACKAGE_MTD=y
# BR2_PACKAGE_MTD_NANDDUMP is not set
# BR2_PACKAGE_MTD_NANDTEST is not set
# BR2_PACKAGE_MTD_NANDWRITE is not set
# BR2_PACKAGE_MTD_UBIATTACH is not set
# BR2_PACKAGE_MTD_UBICRC32 is not set
# BR2_PACKAGE_MTD_UBIDETACH is not set
# BR2_PACKAGE_MTD_UBIFORMAT is not set
# BR2_PACKAGE_MTD_UBIMKVOL is not set
# BR2_PACKAGE_MTD_UBINFO is not set
# BR2_PACKAGE_MTD_UBINIZE is not set
# BR2_PACKAGE_MTD_UBIRENAME is not set
# BR2_PACKAGE_MTD_UBIRMVOL is not set
# BR2_PACKAGE_MTD_UBIRSVOL is not set
# BR2_PACKAGE_MTD_UBIUPDATEVOL is not set
# BR2_PACKAGE_MTD_UBIBLOCK is not set
BR2_PACKAGE_INPUT_EVENT_DAEMON=y
BR2_PACKAGE_UBOOT_TOOLS=y
BR2_PACKAGE_ZLIB=y
BR2_PACKAGE_LIBAD9361_IIO=y
BR2_PACKAGE_LIBGPIOD=y
BR2_PACKAGE_LIBGPIOD_TOOLS=y
BR2_PACKAGE_LIBIIO_IIOD_USBD=y
BR2_PACKAGE_LIBIIO_TESTS=y
BR2_PACKAGE_SOAPYSDR=y
BR2_PACKAGE_SOAPYSDR_UTIL=y
BR2_PACKAGE_SOAPYPLUTOSDR=y
BR2_PACKAGE_LIBINI=y
BR2_PACKAGE_CA_CERTIFICATES=y
BR2_PACKAGE_DROPBEAR=y
BR2_PACKAGE_DROPBEAR_LOCALOPTIONS_FILE="board/pluto/dropbrear_localoptions.h"
BR2_PACKAGE_POLL_SYSFS=y
BR2_PACKAGE_AD936X_REF_CAL=y
BR2_PACKAGE_SDR_IP_GADGET=y
BR2_PACKAGE_SDR_USB_GADGET=y
BR2_TARGET_ROOTFS_CPIO=y
BR2_TARGET_ROOTFS_CPIO_GZIP=y
BR2_TARGET_ROOTFS_CPIO_UIMAGE=y
BR2_PACKAGE_HOST_DOSFSTOOLS=y
BR2_PACKAGE_HOST_GENIMAGE=y
BR2_PACKAGE_HOST_MTOOLS=y

BR2_PRIMARY_SITE="http://sources.buildroot.net"
BR2_TARGET_TZ_INFO=y
BR2_TARGET_TZ_ZONELIST="europe"
BR2_TARGET_LOCALTIME="Europe/Bucharest"

BR2_PACKAGE_BASH=y
BR2_PACKAGE_BUSYBOX_SHOW_OTHERS=y
BR2_PACKAGE_READLINE=y
```

## sources/v02/buildroot/package/soapyplutosdr/Config.in
```kconfig
config BR2_PACKAGE_SOAPYPLUTOSDR
	bool "soapyplutosdr timestamp"
	depends on BR2_INSTALL_LIBSTDCPP
	depends on BR2_TOOLCHAIN_HAS_THREADS
	select BR2_PACKAGE_LIBAD9361_IIO
	select BR2_PACKAGE_LIBIIO_NETWORK_BACKEND
	select BR2_PACKAGE_LIBUSB
	select BR2_PACKAGE_SOAPYSDR
	help
	  SoapySDR module for ADALM-Pluto/Pluto+ direct streaming.
	  This build uses pgreenland's sdr_gadget_timestamping branch,
	  which adds the timestamp_every stream argument required by
	  tetra-bluestation.

comment "soapyplutosdr needs a toolchain with C++ and threads"
	depends on !BR2_INSTALL_LIBSTDCPP || !BR2_TOOLCHAIN_HAS_THREADS
```

## sources/v02/buildroot/package/soapysdr/Config.in
```kconfig
config BR2_PACKAGE_SOAPYSDR
	bool "soapysdr"
	depends on BR2_INSTALL_LIBSTDCPP
	depends on BR2_TOOLCHAIN_HAS_THREADS
	help
	  Vendor-neutral SDR support library and runtime module loader.

	  This package is required by tetra-bluestation through the
	  rust-soapysdr bindings, and by SoapyPlutoSDR.

if BR2_PACKAGE_SOAPYSDR

config BR2_PACKAGE_SOAPYSDR_UTIL
	bool "SoapySDRUtil"
	default y
	help
	  Install the SoapySDRUtil diagnostic utility.

endif

comment "soapysdr needs a toolchain with C++ and threads"
	depends on !BR2_INSTALL_LIBSTDCPP || !BR2_TOOLCHAIN_HAS_THREADS
```
